## firmware/main/Kconfig.projbuild
```kconfig
menu "WardriveESP"

config WARDRIVEESP_GPS_ENABLE
    bool "GPS receiver (UART NMEA)"
    default y
    help
        Read NMEA sentences from a UART GPS module and stream fixes to the phone as WD:GPS lines, so the
        wardrive is stamped with the board's position when the phone's own location is stale or denied. A board
        with nothing wired to the UART just never gets a fix and never advertises the capability, so leaving
        this on is safe for boards without GPS.

config WARDRIVEESP_GPS_UART_NUM
    int "GPS UART controller number"
    default 1
    range 0 2
    depends on WARDRIVEESP_GPS_ENABLE
    help
        UART peripheral to read the GPS from. Leave UART0 for the console; 1 is a safe default on every target.

config WARDRIVEESP_GPS_RX_GPIO
    int "GPS RX GPIO (board pin, wired to the module's TX)"
    default 4
    depends on WARDRIVEESP_GPS_ENABLE
    help
        The GPIO that receives NMEA from the GPS module. Pick a free pin for your board — the default (4) is a
        general-purpose pin on esp32c3/c5/c6/s3 and avoids the USB-serial-JTAG pins.

config WARDRIVEESP_GPS_TX_GPIO
    int "GPS TX GPIO (board pin, wired to the module's RX; -1 to disable)"
    default -1
    depends on WARDRIVEESP_GPS_ENABLE
    help
        Optional — only needed to send configuration to the module. -1 leaves the board's UART TX unconnected,
        which is right for a receive-only NMEA hookup.

config WARDRIVEESP_GPS_BAUD
    int "GPS UART baud rate"
    default 9600
    depends on WARDRIVEESP_GPS_ENABLE
    help
        Most NMEA modules default to 9600.

config WARDRIVEESP_BENCH_TOOLS
    bool "Bench only: diagnostic commands (pinsense)"
    default n
    help
        Adds `pinsense <gpio>`, which reads a pin with the internal pull-up and pull-down (input only) to tell wired
        pins from floating ones. Leave off in published builds.

config WARDRIVEESP_BENCH_RING
    bool "Bench only: drive a WS2812 ring without board detection"
    default n
    help
        For testing the LED effects on a known board before its fingerprint is in board_detect(). Never enable this
        in a published build: it drives the pin below on every board.

config WARDRIVEESP_BENCH_RING_GPIO
    int "Bench ring data GPIO"
    default 23
    depends on WARDRIVEESP_BENCH_RING

config WARDRIVEESP_BENCH_RING_PIXELS
    int "Bench ring pixel count"
    default 6
    range 1 6
    depends on WARDRIVEESP_BENCH_RING

config WARDRIVEESP_BENCH_NO_ADV_SETTLE
    bool "Bench only: advertise the moment Bluetooth is up (no 2 s settle)"
    default n
    help
        Brings back the 1.6.3 timing, when a waiting phone links within about 0.15 s of boot, to reproduce the
        early-link heap corruption. Never enable this in a published build.

config WARDRIVEESP_MEMDIAG
    bool "Bench only: memory and runtime diagnostics (MD lines, diag/bench commands)"
    default n
    help
        Samples heap, the largest free block, task stacks, BLE output buffers, queue depths, allocation failures and
        task watchdog events each second, and keeps one snapshot per interval in a ring in RTC memory that survives a
        software reset. Each snapshot is printed as an "MD ..." line on the USB port. Adds `diag`, `diag dump`,
        `diag clear` and the stress commands `bench mode|alert|drop|lcdlog`, accepted on the USB port without opening
        a session (a session turns Bluetooth off). No WD: protocol change. Leave off in published builds.

config WARDRIVEESP_MEMDIAG_INTERVAL_S
    int "Seconds between diagnostic snapshots"
    default 60
    range 5 3600
    depends on WARDRIVEESP_MEMDIAG

endmenu
```
